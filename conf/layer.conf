## conf/layer.conf
```bitbake
# We have a conf and classes directory, add to BBPATH
BBPATH .= ":${LAYERDIR}"

# We have recipes-* directories, add to BBFILES
BBFILES += "${LAYERDIR}/recipes-*/*/*.bb \
	${LAYERDIR}/recipes-*/*/*.bbappend"

BBFILE_COLLECTIONS += "meta-mediacenter"
BBFILE_PATTERN_meta-mediacenter = "^${LAYERDIR}/"
BBFILE_PRIORITY_meta-mediacenter = "6"
```
